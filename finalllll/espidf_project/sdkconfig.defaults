## finalllll/espidf_project/sdkconfig.defaults
```kconfig
# ESP-IDF Configuration for TWAI ODrive Controller

CONFIG_ESPTOOLPY_FLASHMODE_QIO=y
CONFIG_ESPTOOLPY_FLASHFREQ_80M=y
CONFIG_PARTITION_TABLE_SINGLE_APP=y

# Enable TWAI/TWAI native driver
CONFIG_TWAI_ENABLED=y
CONFIG_TWAI_ISR_IN_IRAM=y
CONFIG_TWAI_SUPPRESS_DEPRECATE_WARN=y

# FreeRTOS settings
CONFIG_FREERTOS_HZ=1000
CONFIG_FREERTOS_UNICORE=n

# Serial console
CONFIG_ESP_CONSOLE_UART_DEFAULT=y
CONFIG_ESP_CONSOLE_UART_BAUDRATE=115200

# Logging
CONFIG_LOG_DEFAULT_LEVEL_INFO=y
CONFIG_LOG_MAXIMUM_LEVEL_VERBOSE=y

# System
CONFIG_ESP_TASK_WDT=y
CONFIG_ESP_DEBUG_OCDAWARE=y
```
